## kernel/Kconfig
```kconfig
menu "KernelSU"

config KSU
	tristate "KernelSU function support"
	depends on KPROBES && EXT4_FS
	default y
	help
	  Enable kernel-level root privileges on Android System.
	  Requires CONFIG_KPROBES for kernel hooking support.
	  Requires CONFIG_EXT4_FS for `ext4_unregister_sysfs`.
	  To compile as a module, choose M here: the
	  module will be called kernelsu.

config KSU_DEBUG
	bool "KernelSU debug mode"
	depends on KSU
	default n
	help
	  Enable KernelSU debug mode.

config KSU_DISABLE_MANAGER
	bool "Disable KernelSU manager integration"
	depends on KSU
	default n
	help
	  Disable manager APK detection and manager-specific handling.
	  Root will be used in place of manager-only functionality.

config KSU_DISABLE_POLICY
	bool "Disable KernelSU policy profiles"
	depends on KSU
	default n
	help
	  Disable per-app root/non-root profile customization.
	  Escalation will always use the default full root profile, and
	  non-root handling will follow the global umount policy only.

config KSU_X86_PATCH_SYSCALL_DISPATCHER
	bool "Dynamically patch x64's hardened syscall dispatcher to support syscall hooks"
	depends on KSU && X86_64
	default n
	help
	  Dynamically patch x64's hardened syscall dispatcher to support syscall hooks. This is a
	  replacement for a kernel source code patch, and is useful for x86_64 LKM mode.

config KSU_SAMSUNG_KDP
	bool "Samsung KDP credential handling"
	depends on KSU && ARM64
	default n
	help
	  Enable Samsung KDP-aware credential installation and reference handling.

config KSU_SAMSUNG_RKP
	bool "Samsung RKP syscall hook fallback"
	depends on KSU && ARM64 && KRETPROBES
	default n
	help
	  Enable kprobe/kretprobe fallbacks when Samsung RKP blocks syscall table writes.

config KSU_SAMSUNG_DEFEX
	bool "Samsung DEFEX credential synchronization"
	depends on KSU && ARM64
	default n
	help
	  Enable Samsung DEFEX credential synchronization and KSU task bypass.

config KSU_SAMSUNG_NO_PATCH_TEXT
	bool "Disable direct kernel text patching on Samsung"
	depends on KSU && ARM64
	default n
	help
	  Disable KernelSU direct text patching, allowing Samsung RKP fallback paths to be used.

endmenu
```
